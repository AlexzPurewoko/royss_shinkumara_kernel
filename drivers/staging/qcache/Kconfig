## drivers/staging/qcache/Kconfig
```kconfig
config QCACHE
	tristate "Dynamic compression of clean pagecache pages"
	depends on CLEANCACHE
	select LZ4_COMPRESS
	select LZ4_DECOMPRESS
	default n
	help
	  Qcache is the backend for fmem
```
